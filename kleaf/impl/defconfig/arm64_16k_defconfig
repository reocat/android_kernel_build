## kleaf/impl/defconfig/arm64_16k_defconfig
```kconfig
# CONFIG_ARM64_4K_PAGES is not set
CONFIG_ARM64_16K_PAGES=y
# CONFIG_ARM64_64K_PAGES is not set
# b/241785095
# CONFIG_INCREMENTAL_FS is not set
```

## kleaf/impl/defconfig/arm64_64k_defconfig
```kconfig
# CONFIG_ARM64_4K_PAGES is not set
# CONFIG_ARM64_16K_PAGES is not set
CONFIG_ARM64_64K_PAGES=y
# b/241785095
# CONFIG_INCREMENTAL_FS is not set
```

## kleaf/impl/defconfig/gcov_defconfig
```kconfig
CONFIG_GCOV_KERNEL=y
CONFIG_GCOV_PROFILE_ALL=y

# TODO: Re-enable when https://github.com/ClangBuiltLinux/linux/issues/1778 is fixed.
# CONFIG_CFI_CLANG is not set
```

## kleaf/impl/defconfig/kasan_defconfig
```kconfig
CONFIG_KASAN=y
CONFIG_KASAN_INLINE=y # nocheck: b/295240936: CONFIG_KASAN_INLINE not supported on aarch64
CONFIG_KCOV=y
# CONFIG_RANDOMIZE_BASE is not set
# CONFIG_KASAN_OUTLINE is not set
CONFIG_FRAME_WARN=0
# CONFIG_SHADOW_CALL_STACK is not set
```

## kleaf/impl/defconfig/kasan_enabled_defconfig
```kconfig
CONFIG_KASAN=y
CONFIG_KASAN_INLINE=y
CONFIG_KCOV=y
# CONFIG_RANDOMIZE_BASE is not set
# CONFIG_KASAN_OUTLINE is not set
CONFIG_FRAME_WARN=0
# CONFIG_SHADOW_CALL_STACK is not set
```

## kleaf/impl/defconfig/kunit_defconfig
```kconfig
# TODO(b/296116800): Turn this to a module
CONFIG_KUNIT=y
CONFIG_KUNIT_ALL_TESTS=y
```

## kleaf/impl/defconfig/rust_defconfig
```kconfig
# Rust Support
# Until Rust is enabled in the primary GKI builds, this fragment enables
# support for Rust and Rust drivers being tested.

CONFIG_RUST=y

# TODO: Remove these once Rust binder is enabled
# They are present to ensure Rust support is being exercised at least minimally
CONFIG_SAMPLES=y
CONFIG_SAMPLES_RUST=y
CONFIG_SAMPLE_RUST_MINIMAL=y
```

## kleaf/tests/ddk_test/my_driver/Kconfig
```kconfig
config FEATURE_X
	bool "FEATURE_X"

config DRIVER_NAME
	string "DRIVER_NAME"

config MAX
	int "MAX"

config MIN
	int "MIN"
```
